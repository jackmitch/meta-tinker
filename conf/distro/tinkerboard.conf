## conf/distro/tinkerboard.conf
```bitbake
DISTRO_NAME = "TinkerBoard OE Linux"
DISTRO_VERSION = "1"
SDK_VENDOR = "-oecore"
SDK_VERSION := "${DISTRO_VERSION}"

TOOLCHAIN_OUTPUTNAME = "${SDK_NAME}-${IMAGE_NAME}-toolchain-${SDK_VERSION}"
TOOLCHAIN_HOST_TASK_append += ""

IMAGE_NAME = "${IMAGE_BASENAME}-${MACHINE}-v${DISTRO_VERSION}"

DISTRO_FEATURES_TINKER = "ext2 nfs vfat"

DISTRO_FEATURES = "${DISTRO_FEATURES_TINKER} ${DISTRO_FEATURES_LIBC_DEFAULT}"

PREFERRED_PROVIDER_jpeg = "libjpeg-turbo"
PREFERRED_PROVIDER_jpeg-native = "libjpeg-turbo-native"

DISTRO_FEATURES_append = " systemd"
VIRTUAL-RUNTIME_init_manager = "systemd"
DISTRO_FEATURES_BACKFILL_CONSIDERED = "sysvinit"
VIRTUAL-RUNTIME_initscripts = ""
EXTRA_IMAGE_FEATURES_append = " ssh-server-dropbear"
```

## conf/layer.conf
```bitbake
# We have a conf and classes directory, add to BBPATH
BBPATH .= ":${LAYERDIR}"
# We have recipes-* directories, add to BBFILES
BBFILES += "${LAYERDIR}/recipes-*/*/*.bb ${LAYERDIR}/recipes-*/*/*.bbappend"
BBFILE_PATTERN_omg-apps = "^${LAYERDIR}/"
BBFILE_PRIORITY_omg-apps = "5"
```

## conf/machine/tinker.conf
```bitbake
require conf/machine/include/tune-cortexa17.inc

MACHINE_EXTRA_RRECOMMENDS += " kernel-modules kernel-devicetree u-boot"

EXTRA_IMAGEDEPENDS += "u-boot"

KERNEL_DEVICETREE = "rk3288-tinker.dtb"

UBOOT_MACHINE = "tinker-rk3288_defconfig"

UBOOT_EXTLINUX = "1"

UBOOT_EXTLINUX_LABELS = "TinkerOE"

UBOOT_EXTLINUX_CONSOLE = "console=ttyS2,115200n8"
UBOOT_EXTLINUX_ROOT = "root=/dev/mmcblk0p1"
UBOOT_EXTLINUX_KERNEL_ARGS = "earlyprintk rw rootwait"
UBOOT_EXTLINUX_FDT = "../rk3288-tinker.dtb"

PREFERRED_PROVIDER_virtual/kernel = "linux-tinkerboard"

KERNEL_IMAGETYPE = "zImage"

SERIAL_CONSOLE_tinkerboard = "115200 ttyS2"
```
